## apps/dds/Kconfig
```kconfig
#
# For a description of the syntax of this configuration file,
# see misc/tools/kconfig-language.txt.
#

config DDS_CHAT
	bool "A simple chat example using DDS over NSH"
	default n
	---help---
		Enable the DDS_CHAT

if DDS_CHAT

config UDP_IPADDR
	hex "Target IP address"
	default 0xc0a80003

config UDP_DRIPADDR
	hex "Target default router address (Gateway)"
	default 0xc0a80002

config UDP_NETMASK
	hex "Network mask"
	default 0xffffff00


endif # DDS_CHAT
```

## apps/examples/dds/Kconfig
```kconfig
#
# For a description of the syntax of this configuration file,
# see misc/tools/kconfig-language.txt.
#

config EXAMPLES_DDS_CHAT
	bool "A simple chat example using DDS over NSH"
	default n
	---help---
		Enable the EXAMPLE_DDS_CHAT
```

## apps/examples/dds_chat/Kconfig
```kconfig
#
# For a description of the syntax of this configuration file,
# see misc/tools/kconfig-language.txt.
#

config EXAMPLES_DDS_CHAT
	bool "A simple chat example using DDS"
	default n
	---help---
		Enable the EXAMPLES_DDS_CHAT
```

## apps/examples/dds_publisher/Kconfig
```kconfig
#
# For a description of the syntax of this configuration file,
# see misc/tools/kconfig-language.txt.
#

config EXAMPLES_DDS_PUBLISHER
	bool "A simple DDS publisher"
	default n
	---help---
		Enable the EXAMPLE_DDS_PUBLISHER

if EXAMPLES_DDS_PUBLISHER

config EXAMPLES_UDP_IPADDR
	hex "Target IP address"
	default 0xc0a80003

config EXAMPLES_UDP_DRIPADDR
	hex "Target default router address (Gateway)"
	default 0xc0a80002

config EXAMPLES_UDP_NETMASK
	hex "Network mask"
	default 0xffffff00


endif # EXAMPLES_UDP
```

## apps/examples/ddsimu/Kconfig
```kconfig
#
# For a description of the syntax of this configuration file,
# see misc/tools/kconfig-language.txt.
#

config EXAMPLES_DDSIMU
	bool "DDS IMU example using an lis302dlh"
	default n
	---help---
		Enable the EXAMPLES_DDSIMU

if EXAMPLES_DDSIMU

config EXAMPLES_UDP_IPADDR
	hex "Target IP address"
	default 0xc0a80003

config EXAMPLES_UDP_DRIPADDR
	hex "Target default router address (Gateway)"
	default 0xc0a80002

config EXAMPLES_UDP_NETMASK
	hex "Network mask"
	default 0xffffff00


endif # EXAMPLES_UDP
```

## apps/examples/imu/Kconfig
```kconfig
#
# For a description of the syntax of this configuration file,
# see misc/tools/kconfig-language.txt.
#

config EXAMPLES_IMU
	bool "\"Hello, IMU!\" example"
	default n
	---help---
		Enable the \"Hello, IMU!\" example
```

## apps/examples/imu_publisher/Kconfig
```kconfig
#
# For a description of the syntax of this configuration file,
# see misc/tools/kconfig-language.txt.
#

config EXAMPLES_IMUPUBLISHER
	bool "DDS IMU publisher"
	default n
	---help---
		Enable the EXAMPLES_IMUPUBLISHER

if EXAMPLES_IMUPUBLISHER

config EXAMPLES_UDP_IPADDR
	hex "Target IP address"
	default 0xc0a80003

config EXAMPLES_UDP_DRIPADDR
	hex "Target default router address (Gateway)"
	default 0xc0a80002

config EXAMPLES_UDP_NETMASK
	hex "Network mask"
	default 0xffffff00


endif # EXAMPLES_UDP
```

## apps/examples/rosimu_publisher/Kconfig
```kconfig
#
# For a description of the syntax of this configuration file,
# see misc/tools/kconfig-language.txt.
#

config EXAMPLES_ROSIMUPUBLISHER
	bool "ROS 2 IMU publisher"
	default n
	---help---
		Enable the EXAMPLES_ROSIMUPUBLISHER

if EXAMPLES_ROSIMUPUBLISHER

config EXAMPLES_UDP_IPADDR
	hex "Target IP address"
	default 0xc0a80003

config EXAMPLES_UDP_DRIPADDR
	hex "Target default router address (Gateway)"
	default 0xc0a80002

config EXAMPLES_UDP_NETMASK
	hex "Network mask"
	default 0xffffff00


endif # EXAMPLES_UDP
```

## apps/examples/talker/Kconfig
```kconfig
#
# For a description of the syntax of this configuration file,
# see misc/tools/kconfig-language.txt.
#

config EXAMPLES_HELLO
	bool "\"Hello, World!\" example"
	default n
	---help---
		Enable the \"Hello, World!\" example

if EXAMPLES_HELLO

config EXAMPLES_HELLO_PROGNAME
	string "Program name"
	default "hello"
	depends on BUILD_KERNEL
	---help---
		This is the name of the program that will be use when the NSH ELF
		program is installed.

config EXAMPLES_UDP_IPADDR
	hex "Target IP address"
	default 0xc0a80003

config EXAMPLES_UDP_DRIPADDR
	hex "Target default router address (Gateway)"
	default 0xc0a80002

config EXAMPLES_UDP_NETMASK
	hex "Network mask"
	default 0xffffff00

endif
```

## apps/examples/threading/Kconfig
```kconfig
#
# For a description of the syntax of this configuration file,
# see misc/tools/kconfig-language.txt.
#

config EXAMPLES_THREADING
	bool "\"Threading!\" example"
	default n
	---help---
		Enable the \"Hello, World!\" example
```

## apps/examples/udp_multithread/Kconfig
```kconfig
#
# For a description of the syntax of this configuration file,
# see misc/tools/kconfig-language.txt.
#

config EXAMPLES_UDPSIMPLE_MULTITHREAD
	bool "UDP Simple Multihread"
	default n
	---help---
		Enable the \"UDP simple Multithread\" example

if EXAMPLES_UDPSIMPLE_MULTITHREAD

config UDP_IPADDR
        hex "Target IP address"
        default 0xc0a80003

config UDP_DRIPADDR
        hex "Target default router address (Gateway)"
        default 0xc0a80002

config UDP_NETMASK
        hex "Network mask"
        default 0xffffff00


endif # EXAMPLES_UDPSIMPLE
```

## apps/examples/udp_multithread_mcast/Kconfig
```kconfig
#
# For a description of the syntax of this configuration file,
# see misc/tools/kconfig-language.txt.
#

config EXAMPLES_UDPSIMPLE_MULTITHREAD_MCAST
	bool "UDP Simple Multihread Multicast"
	default n
	---help---
		Enable the \"UDP simple Multithread Multicast \" example

if EXAMPLES_UDPSIMPLE_MULTITHREAD_MCAST

config UDP_IPADDR
        hex "Target IP address"
        default 0xc0a80003

config UDP_DRIPADDR
        hex "Target default router address (Gateway)"
        default 0xc0a80002

config UDP_NETMASK
        hex "Network mask"
        default 0xffffff00


endif # EXAMPLES_UDPSIMPLE
```

## apps/examples/udpsimple/Kconfig
```kconfig
#
# For a description of the syntax of this configuration file,
# see misc/tools/kconfig-language.txt.
#

config EXAMPLES_UDPSIMPLE
	bool "UDP Simple"
	default n
	---help---
		Enable the \"UDP simple!\" example

if EXAMPLES_UDPSIMPLE

config UDP_IPADDR
        hex "Target IP address"
        default 0xc0a80003

config UDP_DRIPADDR
        hex "Target default router address (Gateway)"
        default 0xc0a80002

config UDP_NETMASK
        hex "Network mask"
        default 0xffffff00


endif # EXAMPLES_UDPSIMPLE
```

## apps/hello/Kconfig
```kconfig
#
# For a description of the syntax of this configuration file,
# see misc/tools/kconfig-language.txt.
#

config HELLO
	bool "\"Hello, World!\" app"
	default n
	---help---
		Enable the \"Hello, World!\" app
```

## apps/ros/Kconfig
```kconfig
#
# For a description of the syntax of this configuration file,
# see misc/tools/kconfig-language.txt.
#

source "$APPSDIR/ros/publisher/Kconfig"
```

## apps/ros/publisher/Kconfig
```kconfig
#
# For a description of the syntax of this configuration file,
# see misc/tools/kconfig-language.txt.
#

config ROS_PUBLISHER
	bool "A simple ROS publisher"
	default n
	---help---
		Enable the CONFIG_ROS_PUBLISHER

if ROS_PUBLISHER

config EXAMPLES_UDP_IPADDR
	hex "Target IP address"
	default 0xc0a80003

config EXAMPLES_UDP_DRIPADDR
	hex "Target default router address (Gateway)"
	default 0xc0a80002

config EXAMPLES_UDP_NETMASK
	hex "Network mask"
	default 0xffffff00


endif # ROS_PUBLISHER
```

## apps/udpsimple/Kconfig
```kconfig
#
# For a description of the syntax of this configuration file,
# see misc/tools/kconfig-language.txt.
#

config UDP_SIMPLE
	bool "UDP example simple"
	default n
	---help---
		Enable the UDP SIMPLE example
```

## misc/buildroot/toolchain/binutils/Config.in
```kconfig
# Choose binutils version.

comment "Binutils Options"

config BR2_PACKAGE_BINUTILS
	bool "Build binutils"
	default n
	help
		Build the binutils for the target architecture.

choice
	prompt "Binutils Version"
	default BR2_BINUTILS_VERSION_2_19_1 if BR2_GCC_CORTEX
	default BR2_BINUTILS_VERSION_2_19 if !BR2_avr32 && !BR2_GCC_CORTEX && !BR2_m9s12x
	default BR2_BINUTILS_VERSION_2_18 if BR2_m9s12x
	default BR2_BINUTILS_VERSION_2_17 if !BR2_GCC_CORTEX && !BR2_m9s12x
	depends on BR2_PACKAGE_BINUTILS
	help
	  Select the version of binutils you wish to use.

	config BR2_BINUTILS_VERSION_2_17
		depends !BR2_nios2 && !BR2_cortex_a5 && !BR2_cortex_a8 && !BR2_cortex_m3 && !BR2_cortex_m0 && !BR2_m9s12x
		bool "binutils 2.17"

	config BR2_BINUTILS_VERSION_2_18
		depends !BR2_avr32 && !BR2_nios2 && !BR2_cortex_a5 && !BR2_cortex_a8 && !BR2_cortex_m3 && !BR2_cortex_m0
		bool "binutils 2.18"

	config BR2_BINUTILS_VERSION_2_19
		depends !BR2_avr32 && !BR2_nios2 && !BR2_cortex_a5 && !BR2_cortex_a8 && !BR2_cortex_m3 && !BR2_cortex_m0 &&!BR2_m9s12x
		bool "binutils 2.19"

	config BR2_BINUTILS_VERSION_2_19_1
		depends !BR2_avr32 && !BR2_nios2 && !BR2_m9s12x
		bool "binutils 2.19.1"

	config BR2_BINUTILS_VERSION_2_21_1
		depends !BR2_avr32 && !BR2_nios2 && !BR2_m9s12x
		bool "binutils 2.21.1"

	config BR2_BINUTILS_VERSION_2_22
		depends !BR2_avr32 && !BR2_nios2 && !BR2_m9s12x
		bool "binutils 2.22"

	config BR2_BINUTILS_VERSION_2_24
		depends !BR2_avr32 && !BR2_nios2 && !BR2_m9s12x
		bool "binutils 2.24"

endchoice

config BR2_BINUTILS_VERSION
	string
	depends on BR2_PACKAGE_BINUTILS
	default "2.17"            if BR2_BINUTILS_VERSION_2_17
	default "2.18"            if BR2_BINUTILS_VERSION_2_18
	default "2.19"            if BR2_BINUTILS_VERSION_2_19
	default "2.19.1"          if BR2_BINUTILS_VERSION_2_19_1
	default "2.21.1"          if BR2_BINUTILS_VERSION_2_21_1
	default "2.22"            if BR2_BINUTILS_VERSION_2_22
	default "2.24"            if BR2_BINUTILS_VERSION_2_24

config BR2_EXTRA_BINUTILS_CONFIG_OPTIONS
	string "Additional binutils options"
	default ""
	depends on BR2_PACKAGE_BINUTILS
	help
	  Any additional binutils options you may want to include ...
```

## misc/buildroot/toolchain/kconfig-frontends/Config.in
```kconfig
config BR2_PACKAGE_KCONFIG_FRONTENDS
	bool "Build kconfig-frontends"
	default y
	help
	  The kconfig-frontends are required to configure NuttX.  See
	  http://ymorin.is-a-geek.org/projects/kconfig-frontends

	  NOTE: You must have the ncurses library installed on your computer

if BR2_PACKAGE_KCONFIG_FRONTENDS

config BR2_NCONF_FRONTEND
	bool "Build nconfig frontend"
	default n
	help
	  NOTE: You must have the ncurses library installed on your computer

config BR2_GCONF_FRONTEND
	bool "Build GTK gconf frontend"
	default n
	help
	  NOTE: You must have the QTK developer library installed on your computer

config BR2_QCONF_FRONTEND
	bool "Build Qt qconfig frontend"
	default n
	help
	  NOTE: You must have the QTK developer library installed on your computer

config BR2_KCONFIG_FRONTENDS_VERSION
	string
	default "3.12.0.0"

endif # BR2_PACKAGE_KCONFIG_FRONTENDS
```

## misc/buildroot/toolchain/nxflat/Config.in
```kconfig
comment "NuttX Binary Support"

config BR2_PACKAGE_NXFLAT
	bool "Build NXFLAT tools"
	default n
	depends on BR2_arm
	select BR2_PACKAGE_BINUTILS
	help
	  Build tools need to build NuttX NXFLAT load-able binary
```
